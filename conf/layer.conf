## conf/layer.conf
```bitbake
# We have a conf and classes directory, add to BBPATH
BBPATH .= ":${LAYERDIR}"

# We have recipes-* directories, add to BBFILES
BBFILES += "${LAYERDIR}/recipes-*/*/*.bb \
	${LAYERDIR}/recipes-*/*/*.bbappend"

BBFILE_COLLECTIONS += "wscryptohw"
BBFILE_PATTERN_wscryptohw = "^${LAYERDIR}/"
BBFILE_PRIORITY_wscryptohw = "6"
```
